## boards/arm/custom_nrf52833/custom_nrf52833_defconfig
```kconfig
# custom_nrf52833_defconfig

CONFIG_SOC="nRF52833_QIAA"
CONFIG_SOC_SERIES_NRF52X=y
CONFIG_ARCH="arm"
CONFIG_CPU_CORTEX_M4=y
CONFIG_BOARD_CUSTOM_NRF52833=y
CONFIG_BOARD_ENABLE_DCDC=y
CONFIG_BOARD_ENABLE_DCDC_HV=n
```
